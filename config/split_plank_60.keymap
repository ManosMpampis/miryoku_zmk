
#define MIRYOKU_KEYS_60

#define MIRYOKU_MAPPING_EXTENDED_THUMBS
#define MIRYOKU_MAPPING_PINKIE_STAGGER

#include "../miryoku/custom_config.h"
#include "../miryoku/mapping/60/split_plank_60.h"
#include "../miryoku/miryoku.dtsi"
